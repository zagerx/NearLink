## BS25_1.10.113/DK225_01/application/samples/products/Kconfig
```kconfig
#===============================================================================
# @brief    Kconfig file.
# Copyright (c) @CompanyNameMagicTag 2023-2023. All rights reserved.
#===============================================================================
config ENABLE_ALL_PRODUCTS_SAMPLE
    bool
    prompt "Enable all the sample of product, it's just for build."
    default n
    depends on ENABLE_PRODUCTS_SAMPLE
    select SAMPLE_SUPPORT_SLE_UART
    select SAMPLE_SUPPORT_BLE_UART
    select SAMPLE_SUPPORT_SLE_GAMEPAD_WITH_DONGLE
    select SAMPLE_SUPPORT_SLE_KEYBOARD_WITH_DONGLE
    select SAMPLE_SUPPORT_RCU
    select SAMPLE_SUPPORT_USB_MOUSE
    select SAMPLE_SUPPORT_SLE_MOUSE_WITH_DONGLE
    select SAMPLE_SUPPORT_DUAL_MODE
    select SAMPLE_SUPPORT_BLE_MOUSE
    select SAMPLE_SUPPORT_BLE_KEYBOARD
    select SAMPLE_SUPPORT_BLE_KEYBOARD_SIMULATOR
    select SAMPLE_SUPPORT_USB_VDT
    select SAMPLE_SUPPORT_SLE_VDT_WITH_DONGLE
    select SAMPLE_SUPPORT_USB_KEYBOARD
    select SAMPLE_SUPPORT_USB_AMIC_VDT if ADC_SUPPORT_AMIC
    select SAMPLE_SUPPORT_USB_GAMEPAD
    select SAMPLE_SUPPORT_USB_MICROPHONE
    select SAMPLE_SUPPORT_SLE_MICROPHONE
    select SAMPLE_SUPPORT_BLE_SLE_TAG
    help
        This option means enable all the sample of product, it is just for build.

config SAMPLE_SUPPORT_SLE_UART
    bool
    prompt "Support SLE UART sample."
    default n
    depends on ENABLE_PRODUCTS_SAMPLE
    help
        This option means support SLE UART Sample.

if SAMPLE_SUPPORT_SLE_UART
menu "SLE UART Sample Configuration"
    osource "application/samples/products/sle_uart/Kconfig"
endmenu
endif

config SAMPLE_SUPPORT_BLE_UART
    bool
    prompt "Support BLE UART sample."
    default n
    depends on ENABLE_PRODUCTS_SAMPLE
    help
        This option means support BLE UART Sample.

if SAMPLE_SUPPORT_BLE_UART
menu "BLE UART Sample Configuration"
    osource "application/samples/products/ble_uart/Kconfig"
endmenu
endif

config SAMPLE_SUPPORT_SLE_AMIC_VDT_WITH_DONGLE
    bool
    prompt "Support SLE AMIC Voice Data Transmission With Dongle sample."
    default n
    depends on ENABLE_PRODUCTS_SAMPLE
    help
        This option means support SLE AMIC Voice Data Transmission With Dongle Sample.

if SAMPLE_SUPPORT_SLE_AMIC_VDT_WITH_DONGLE
menu "SLE AMIC Voice Data Transmission With Dongle Sample Configuration"
    osource "application/samples/products/sle_amic_vdt_with_dongle/Kconfig"
endmenu
endif

config SAMPLE_SUPPORT_SLE_GAMEPAD_WITH_DONGLE
    bool
    prompt "Support SLE GAMEPAD With Dongle sample."
    default n
    depends on ENABLE_PRODUCTS_SAMPLE
    help
        This option means support SLE GAMEPAD Sample.

if SAMPLE_SUPPORT_SLE_GAMEPAD_WITH_DONGLE
menu "SLE GAMEPAD With Dongle Sample Configuration"
    osource "application/samples/products/sle_gamepad_with_dongle/Kconfig"
endmenu
endif

config SAMPLE_SUPPORT_SLE_KEYBOARD_WITH_DONGLE
    bool
    prompt "Support SLE KEYBOARD With Dongle sample."
    default n
    depends on ENABLE_PRODUCTS_SAMPLE
    help
        This option means support SLE KEYBOARD Sample.

if SAMPLE_SUPPORT_SLE_KEYBOARD_WITH_DONGLE
menu "SLE KeyBoard With Dongle Sample Configuration"
    osource "application/samples/products/sle_keyboard_with_dongle/Kconfig"
endmenu
endif

config SAMPLE_SUPPORT_RCU
    bool
    prompt "Support RCU sample."
    default n
    depends on ENABLE_PRODUCTS_SAMPLE
    help
        This option means support RCU Sample.

if SAMPLE_SUPPORT_RCU
menu "rcu Sample Configuration"
    osource "application/samples/products/rcu/Kconfig"
endmenu
endif

config SAMPLE_SUPPORT_USB_MOUSE
    bool
    prompt "Support USB mouse sample."
    default n
    depends on ENABLE_PRODUCTS_SAMPLE
    help
        This option means support USB mouse Sample.

if SAMPLE_SUPPORT_USB_MOUSE
menu "USB Mouse Sample Configuration"
    osource "application/samples/products/usb_mouse/Kconfig"
endmenu
endif

config SAMPLE_SUPPORT_SLE_MOUSE_WITH_DONGLE
    bool
    prompt "Support SLE Mouse With Dongle sample."
    default n
    depends on ENABLE_PRODUCTS_SAMPLE
    help
        This option means support SLE Mouse Sample.

if SAMPLE_SUPPORT_SLE_MOUSE_WITH_DONGLE
menu "SLE Mouse With Dongle Sample Configuration"
    osource "application/samples/products/sle_mouse_with_dongle/Kconfig"
endmenu
endif


config SAMPLE_SUPPORT_BLE_MOUSE
    bool
    prompt "Support BLE Mouse sample."
    default n
    depends on ENABLE_PRODUCTS_SAMPLE
    help
        This option means support BLE Mouse Sample.

if SAMPLE_SUPPORT_BLE_MOUSE
    osource "application/samples/products/ble_mouse/mouse_sensor/Kconfig"
endif

config SAMPLE_SUPPORT_DUAL_MODE
    bool
    prompt "Support BLE and SLE dual mode sample."
    default n
    depends on ENABLE_PRODUCTS_SAMPLE
    help
        This option means support BLE or SLE Mode Sample.

if SAMPLE_SUPPORT_DUAL_MODE
menu "BLE and SLE Dual Mode Sample Configuration"
    osource "application/samples/products/dual_mode/Kconfig"
endmenu
endif

menu "Mouse Pin Configuration"
visible if SAMPLE_SUPPORT_BLE_MOUSE || SAMPLE_SUPPORT_USB_MOUSE || SAMPLE_SUPPORT_SLE_MOUSE_WITH_DONGLE
depends on ENABLE_PRODUCTS_SAMPLE
config MOUSE_PIN_LEFT
    int
    prompt "Mouse left key pinnum."
    default 0
config MOUSE_PIN_MID
    int
    prompt "Mouse middle key pinnum."
    default 1
config MOUSE_PIN_RIGHT
    int
    prompt "Mouse right key pinnum."
    default 2
config MOUSE_PIN_QDEC_A
    int
    prompt "Mouse qdec a pinnum."
    default 3
config MOUSE_PIN_QDEC_B
    int
    prompt "Mouse qdec b pinnum."
    default 4
config MOUSE_PIN_QDEC_COMMON
    int
    prompt "Mouse qdec common pinnum."
    default 5
config MOUSE_PIN_NRESET
    int
    prompt "Mouse sensor reset pinnum."
    default 21
config MOUSE_PIN_MONTION
    int
    prompt "Mouse sensor montion pinnum."
    default 6
config MOUSE_PIN_SPI_CLK
    int
    prompt "Mouse SPI clk pinnum."
    default 18
config MOUSE_PIN_SPI_CS
    int
    prompt "Mouse SPI cs pinnum."
    default 19
config MOUSE_PIN_SPI_MOSI
    int
    prompt "Mouse SPI MOSI pinnum."
    default 17
config MOUSE_PIN_SPI_MISO
    int
    prompt "Mouse SPI MISO pinnum."
    default 16
config MOUSE_ADC_VBAT_CH
    int
    prompt "Mouse VBAT measurement channel."
    default 7
config MOUSE_ADC_VBAT_PIN
    int
    prompt "Mouse VBAT measurement pin."
    default 2  if MOUSE_ADC_VBAT_CH = 0
    default 3  if MOUSE_ADC_VBAT_CH = 1
    default 4  if MOUSE_ADC_VBAT_CH = 2
    default 5  if MOUSE_ADC_VBAT_CH = 3
    default 28 if MOUSE_ADC_VBAT_CH = 4
    default 29 if MOUSE_ADC_VBAT_CH = 5
    default 30 if MOUSE_ADC_VBAT_CH = 6
    default 31 if MOUSE_ADC_VBAT_CH = 7
endmenu

config SAMPLE_SUPPORT_BLE_KEYBOARD
    bool
    prompt "Support BLE Keyboard sample."
    default n
    depends on ENABLE_PRODUCTS_SAMPLE
    help
        This option means support BLE Keyboard Sample.

config SAMPLE_SUPPORT_BLE_KEYBOARD_SIMULATOR
    bool
    prompt "Support BLE Keyboard sample simulator."
    default n
    depends on ENABLE_PRODUCTS_SAMPLE
    help
        This option means support BLE Keyboard Sample.

config SAMPLE_SUPPORT_USB_VDT
    bool
    prompt "Support USB Voice Data Transmission sample."
    default n
    depends on ENABLE_PRODUCTS_SAMPLE
    help
        This option means support USB Voice Data Transmission Sample.

if SAMPLE_SUPPORT_USB_VDT
menu "USB Voice Data Transmission Sample Configuration"
    osource "application/samples/products/usb_voice_data_transmission/Kconfig"
endmenu
endif

config SAMPLE_SUPPORT_SLE_VDT_WITH_DONGLE
    bool
    prompt "Support SLE Voice Data Transmission With Dongle sample."
    default n
    depends on ENABLE_PRODUCTS_SAMPLE
    help
        This option means support SLE Voice Data Transmission With Dongle Sample.

if SAMPLE_SUPPORT_SLE_VDT_WITH_DONGLE
menu "SLE Voice Data Transmission With Dongle Sample Configuration"
    osource "application/samples/products/sle_voice_data_trans_with_dongle/Kconfig"
endmenu
endif

config SAMPLE_SUPPORT_USB_KEYBOARD
    bool
    prompt "Support USB keyboard sample."
    default n
    depends on ENABLE_PRODUCTS_SAMPLE
    help
        This option means support Keyboard Sample.

config SAMPLE_SUPPORT_USB_AMIC_VDT
    bool
    prompt "Support USB AMIC VOICE sample."
    default n
    depends on ENABLE_PRODUCTS_SAMPLE && ADC_SUPPORT_AMIC
    help
        This option means support USB AMIC VOICE Sample.

if SAMPLE_SUPPORT_USB_AMIC_VDT
menu "USB AMIC VOICE Sample Configuration"
    osource "application/samples/products/usb_amic_vdt/Kconfig"
endmenu
endif

config SAMPLE_SUPPORT_USB_GAMEPAD
    bool
    prompt "Support USB gamepad sample."
    default n
    depends on ENABLE_PRODUCTS_SAMPLE
    help
        This option means support Gamepad Sample.

config SAMPLE_SUPPORT_USB_MICROPHONE
    bool
    prompt "Support USB micophone sample."
    default n
    depends on ENABLE_PRODUCTS_SAMPLE
    select I2S_SUPPORT_DMA
    help
        This option means support micpphone Sample.

if SAMPLE_SUPPORT_USB_MICROPHONE
menu "MICPHONE USB Sample Configuration"
    osource "application/samples/products/usb_micophone/Kconfig"
endmenu
endif

config SAMPLE_SUPPORT_SLE_MICROPHONE
    bool
    prompt "Support SLE Microphone sample."
    default n
    depends on ENABLE_PRODUCTS_SAMPLE
    help
        This option means support SLE Microphone Sample.

if SAMPLE_SUPPORT_SLE_MICROPHONE
menu "SLE Microphone sample Configuration"
    osource "application/samples/products/sle_microphone/Kconfig"
endmenu
endif

config SAMPLE_SUPPORT_BLE_SLE_TAG
    bool
    prompt "Support Ble Sle tag sample."
    default n
    depends on ENABLE_PRODUCTS_SAMPLE
    help
        This option means support SLE Mouse Sample.

config SAMPLE_SUPPORT_AIR_MOUSE_WITH_DONGLE
    bool
    prompt "Support air mouse sample."
    default n
    depends on ENABLE_PRODUCTS_SAMPLE
    help
        This option means support Air Mouse Sample.

if SAMPLE_SUPPORT_AIR_MOUSE_WITH_DONGLE
menu "Air Mouse sample Configuration"
    osource "application/samples/products/air_mouse/Kconfig"
endmenu
endif
```

## BS25_1.10.113/DK225_01/application/samples/products/air_mouse/Kconfig
```kconfig
#===============================================================================
# @brief    Kconfig file.
# Copyright (c) @CompanyNameMagicTag 2023-2023. All rights reserved.
#===============================================================================

choice
    prompt "Select AIR MOUSE type"
    default SAMPLE_SUPPORT_AIR_MOUSE
    config SAMPLE_SUPPORT_AIR_MOUSE
        bool "Enable AIR MOUSE sample."
    config SAMPLE_SUPPORT_AIR_MOUSE_DONGLE
        bool "Enable AIR MOUSE Dongle sample."
endchoice

choice
    prompt "Select AIR MOUSE board"
    default AIR_MOUSE_SELF_BOARD
    config AIR_MOUSE_SELF_BOARD
        bool "Self Board."
    config AIR_MOUSE_HR_BOARD
        bool "HR Board."
endchoice
```

## BS25_1.10.113/DK225_01/application/samples/products/dual_mode/Kconfig
```kconfig
#===============================================================================
# @brief    Kconfig file.
# Copyright (c) @CompanyNameMagicTag 2023-2023. All rights reserved.
#===============================================================================

choice
    prompt "Select SLE type"
    default SAMPLE_DUAL_MODE_SLE_SERVER
    config SAMPLE_DUAL_MODE_SLE_SERVER
        bool "Enable SLE server sample."
    config SAMPLE_DUAL_MODE_SLE_CLIENT
        bool "Enable SLE client sample."
endchoice

menu "Select SLE server protocol"
    config SUPPORT_SLE_PERIPHERAL
        bool
        prompt "Select sle peripheral"
        default y
        depends on SAMPLE_DUAL_MODE_SLE_SERVER

    config SUPPORT_SLE_CENTRAL
        bool 
        prompt "Select sle central"
        default n
        depends on SAMPLE_DUAL_MODE_SLE_CLIENT
endmenu
```

## BS25_1.10.113/DK225_01/application/samples/products/sle_amic_vdt_with_dongle/Kconfig
```kconfig
#===============================================================================
# @brief    Kconfig file.
# Copyright (c) @CompanyNameMagicTag 2023-2023. All rights reserved.
#===============================================================================
choice
    prompt "Select SLE type"
    default SAMPLE_SUPPORT_SLE_AMIC_VDT_DONGLE
    config SAMPLE_SUPPORT_SLE_AMIC_VDT_DONGLE
        bool "Enable SLE Dongle sample."
    config SAMPLE_SUPPORT_SLE_AMIC_VDT_SERVER
        bool "Enable SLE Server sample."
endchoice

choice
    prompt "Select PDM sample rate"
    default SLE_PDM_AMIC_SAMPLE_RATE_16K
    config SLE_PDM_AMIC_SAMPLE_RATE_8K
        bool "PDM sample rate is 8K"
    config SLE_PDM_AMIC_SAMPLE_RATE_16K
        bool "PDM sample rate is 16K"
    config SLE_PDM_AMIC_SAMPLE_RATE_32K
        bool "PDM sample rate is 32K"
    config SLE_PDM_AMIC_SAMPLE_RATE_48K
        bool "PDM sample rate is 48K"
    config SLE_PDM_AMIC_SAMPLE_RATE_96K
        bool "PDM sample rate is 96K"
endchoice

config USB_UAC_MAX_RECORD_SIZE
    hex
    prompt "Set the max recorder size of USB UAC."
    depends on SAMPLE_SUPPORT_SLE_AMIC_VDT_SERVER
    default 0x400
    help
        This option means the max recorder size of USB UAC.

config USB_PDM_TRANSFER_LEN_BY_DMA
    int
    prompt "Set the length of transfer by DMA."
    depends on SAMPLE_SUPPORT_SLE_AMIC_VDT_SERVER
    default 128
    help
        This option means the length of transfer by DMA.

config ADC_USE_PIN1
    int
    prompt "Choose ADC USE pin1."
    depends on SAMPLE_SUPPORT_SLE_AMIC_VDT_SERVER
    default 30

config ADC_USE_PIN2
    int
    prompt "Choose ADC USE pin2."
    depends on SAMPLE_SUPPORT_SLE_AMIC_VDT_SERVER
    default 31

config ADC_PIN_MODE
    int
    prompt "Choose ADC pin mode."
    depends on SAMPLE_SUPPORT_SLE_AMIC_VDT_SERVER
    default 0
```

## BS25_1.10.113/DK225_01/application/samples/products/usb_amic_vdt/Kconfig
```kconfig
#===============================================================================
# @brief    Kconfig file.
# Copyright (c) @CompanyNameMagicTag 2023-2023. All rights reserved.
#===============================================================================
config USB_UAC_MAX_RECORD_SIZE
    hex
    prompt "Set the max recorder size of USB UAC."
    default 0x800
    help
        This option means the max recorder size of USB UAC.

config USB_PDM_TRANSFER_LEN_BY_DMA
    int
    prompt "Set the length of transfer by DMA."
    default 32
    help
        This option means the length of transfer by DMA.

config ADC_USE_PIN1
    int
    prompt "Choose ADC USE pin1."
    depends on SAMPLE_SUPPORT_USB_AMIC_VDT
    default 30

config ADC_USE_PIN2
    int
    prompt "Choose ADC USE pin2."
    depends on SAMPLE_SUPPORT_USB_AMIC_VDT
    default 31

config ADC_PIN_MODE
    int
    prompt "Choose ADC pin mode."
    depends on SAMPLE_SUPPORT_USB_AMIC_VDT
    default 0
```

## BS25_1.10.113/DK225_01/drivers/drivers/driver/audio/riscv_codec/codec/Kconfig
```kconfig
#===============================================================================
# @brief    Kconfig file.
# Copyright (c) @CompanyNameMagicTag 2022-2022. All rights reserved.
#===============================================================================

config DRIVER_SUPPORT_AUDIO_CODEC
    bool
    prompt "AUDIO_CODEC"
    default y
    help 
        This option means support audio codec.

if DRIVER_SUPPORT_AUDIO_CODEC
menu "AUDIO_CODEC Configuration"
    comment "Config audio codec"
    osource "drivers/drivers/driver/audio/riscv_codec/codec/ha_codec/Kconfig"
endmenu
endif
```
