## BS25_1.10.113/DK225_01/drivers/drivers/driver/audio/riscv_codec/codec/ha_codec/Kconfig
```kconfig
#===============================================================================
# @brief    Kconfig file.
# Copyright (c) @CompanyNameMagicTag 2022-2022. All rights reserved.
#===============================================================================

#sbc
config DRIVER_SUPPORT_SBC
    bool
    prompt "SBC_CODEC"
    default y
    help 
        This option means support sbc codec.

if DRIVER_SUPPORT_SBC
menu "SBC_DEC Configuration"
    comment "Config SBC DEC"
    osource "drivers/drivers/driver/audio/riscv_codec/codec/ha_codec/sbc_dec/Kconfig"
endmenu

menu "SBC_ENC Configuration"
    comment "Config SBC ENC"
    osource "drivers/drivers/driver/audio/riscv_codec/codec/ha_codec/sbc_enc/Kconfig"
endmenu
endif

#opus
config DRIVER_SUPPORT_OPUS
    bool
    prompt "OPUS_CODEC"
    default y
    help 
        This option means support opus codec.

if DRIVER_SUPPORT_OPUS
menu "OPUS_DEC Configuration"
    comment "Config OPUS DEC"
    osource "drivers/drivers/driver/audio/riscv_codec/codec/ha_codec/opus_dec/Kconfig"
endmenu

menu "OPUS_ENC Configuration"
    comment "Config OPUS ENC"
    osource "drivers/drivers/driver/audio/riscv_codec/codec/ha_codec/opus_enc/Kconfig"
endmenu
endif

#l2hc
config DRIVER_SUPPORT_L2HC
    bool
    prompt "L2HC_CODEC"
    default y
    help 
        This option means support l2hc codec.

if DRIVER_SUPPORT_L2HC
menu "L2HC_DEC Configuration"
    comment "Config L2HC DEC"
    osource "drivers/drivers/driver/audio/riscv_codec/codec/ha_codec/l2hc_dec/Kconfig"
endmenu

menu "L2HC_ENC Configuration"
    comment "Config L2HC ENC"
    osource "drivers/drivers/driver/audio/riscv_codec/codec/ha_codec/l2hc_enc/Kconfig"
endmenu
endif
```

## BS25_1.10.113/DK225_01/drivers/drivers/driver/audio/riscv_codec/codec/ha_codec/l2hc_dec/Kconfig
```kconfig
#===============================================================================
# @brief    Kconfig file.
# Copyright (c) @CompanyNameMagicTag 2022-2022. All rights reserved.
#===============================================================================

config L2HC_DEC
    bool
    prompt "L2HC_DEC"
    default y
    help
        This option means support audio L2HC_DEC.

if L2HC_DEC
config L2HC_DEC_16K_LIB
    bool
    prompt "L2HC 16k samplerate lib"
    default y

config L2HC_DEC_48K_LIB
    bool
    prompt "L2HC 48k samplerate lib"
    default n
endif
```

## BS25_1.10.113/DK225_01/drivers/drivers/driver/audio/riscv_codec/codec/ha_codec/l2hc_enc/Kconfig
```kconfig
#===============================================================================
# @brief    Kconfig file.
# Copyright (c) @CompanyNameMagicTag 2022-2022. All rights reserved.
#===============================================================================

config L2HC_ENC
    bool
    prompt "L2HC_ENC"
    default y
    help
        This option means support audio L2HC_ENC.

if L2HC_ENC
config L2HC_ENC_16k_LIB
    bool
    prompt "L2HC 16k samplerate lib"
    default y

config L2HC_ENC_48k_LIB
    bool
    prompt "L2HC 48k samplerate lib"
    default n
endif
```

## BS25_1.10.113/DK225_01/drivers/drivers/driver/audio/riscv_codec/codec/ha_codec/opus_dec/Kconfig
```kconfig
#===============================================================================
# @brief    Kconfig file.
# Copyright (c) @CompanyNameMagicTag 2022-2022. All rights reserved.
#===============================================================================

config OPUS_DEC
    bool
    prompt "OPUS_DEC"
    default y
    help
        This option means support audio OPUS_DEC.

if OPUS_DEC
config OPUS_DEC_30K_TO_ITCM
    bool
    prompt "opus dec link 30k to ITCM"
    default y

config OPUS_DEC_ALL_TO_ITCM
    bool
    prompt "opus dec link all files to ITCM"
    default n
endif
```

## BS25_1.10.113/DK225_01/drivers/drivers/driver/audio/riscv_codec/codec/ha_codec/opus_enc/Kconfig
```kconfig
#===============================================================================
# @brief    Kconfig file.
# Copyright (c) @CompanyNameMagicTag 2022-2022. All rights reserved.
#===============================================================================

config OPUS_ENC
    bool
    prompt "OPUS_ENC"
    default y
    help
        This option means support audio OPUS_ENC.

if OPUS_ENC
config OPUS_ENC_30K_TO_ITCM
    bool
    prompt "opus enc link 30k to ITCM"
    default y

if OPUS_ENC_30K_TO_ITCM
config OPUS_ENC_48K_2_5MS_VERSION
    bool
    prompt "opus enc for 48k samplerate 2.5ms"
    default n
endif

config OPUS_ENC_ALL_TO_ITCM
    bool
    prompt "opus enc link all files to ITCM"
    default n
endif
```

## BS25_1.10.113/DK225_01/drivers/drivers/driver/audio/riscv_codec/codec/ha_codec/sbc_dec/Kconfig
```kconfig
#===============================================================================
# @brief    Kconfig file.
# Copyright (c) @CompanyNameMagicTag 2022-2022. All rights reserved.
#===============================================================================

config SBC_DEC
    bool
    prompt "SBC_DEC"
    default y
    help
        This option means support audio SBC_DEC.

if SBC_DEC
config SBC_DEC_7K_TO_ITCM
    bool
    prompt "sbc dec link 6.34k to ITCM"
    default y

config SBC_DEC_ALL_TO_ITCM
    bool
    prompt "sbc dec link all files (12.22k) to ITCM"
    default n
endif
```

## BS25_1.10.113/DK225_01/drivers/drivers/driver/audio/riscv_codec/codec/ha_codec/sbc_enc/Kconfig
```kconfig
#===============================================================================
# @brief    Kconfig file.
# Copyright (c) @CompanyNameMagicTag 2022-2022. All rights reserved.
#===============================================================================

config SBC_ENC
    bool
    prompt "SBC_ENC"
    default y
    help
        This option means support audio SBC_ENC.

if SBC_ENC
config SBC_ENC_5K_TO_ITCM
    bool
    prompt "sbc enc link 4.52k to ITCM"
    default y

config SBC_ENC_ALL_TO_ITCM
    bool
    prompt "sbc enc link all files (8.48k) to ITCM"
    default n
endif
```

## BS25_1.10.113/DK225_01/drivers/drivers/driver/ipc/Kconfig
```kconfig
#===============================================================================
# @brief    Kconfig file.
# Copyright (c) @CompanyNameMagicTag 2022-2022. All rights reserved.
#===============================================================================

config IPC_USING_SW_MAILBOX
    bool
    prompt "Using the software mailbox"
    default y
    depends on DRIVER_SUPPORT_IPC

config IPC_USING_RING_BUFFER_MAILBOX
    bool
    prompt "Using the Ring Buffer mailbox"
    default n
    depends on DRIVER_SUPPORT_IPC

config IPC_USING_HW_MAILBOX
    bool
    prompt "Using the Hardware mailbox"
    default n
    depends on DRIVER_SUPPORT_IPC

config IPC_SEND_MSG_MAX_WAIT_TIME_MS
    hex
    prompt "The timeout of IPC wait condition when IPC send message synchronously, uint is ms"
    default 0x400
```

## BS25_1.10.113/DK225_01/drivers/drivers/hal/eflash/Kconfig
```kconfig
#===============================================================================
# @brief    Kconfig file.
# Copyright (c) @CompanyNameMagicTag 2023-2023. All rights reserved.
#===============================================================================
config VIRTUAL_EMBED_FLASH
    bool
    prompt "adapt fpga"
    default y
    depends on DRIVER_SUPPORT_EFLASH

config REAL_EMBED_FLASH
    bool
    prompt "adapt asic"
    default y
    depends on DRIVER_SUPPORT_EFLASH

config ERASE_VERIFY
    bool
    prompt "Verify mode erase operation"
    default y
    depends on REAL_EMBED_FLASH

config PULL_UP_PULL_DOWN_WRITE
    bool
    prompt "protect eflash"
    default y
    depends on DRIVER_SUPPORT_EFLASH

config SET_NVR_FUNCTION
    bool
    prompt "set CFG_NVR"
    default y
    depends on DRIVER_SUPPORT_EFLASH
```

## BS25_1.10.113/DK225_01/protocol/Kconfig
```kconfig
#===============================================================================
# @brief    Kconfig file.
# Copyright (c) @CompanyNameMagicTag 2023-2023. All rights reserved.
#===============================================================================
menu "bt_host"
    comment "Config bluetooth."
    osource "protocol/bt/host/Kconfig"
endmenu

menu "bt_controller"
    comment "Config bluetooth."
    osource "protocol/bt/controller/Kconfig"
endmenu

menu "nfc"
    comment "Config nfc."
endmenu

menu "wifi"
    comment "Config wifi."
endmenu

menu "radar"
    comment "Config radar."
    osource "protocol/radar/plat/Kconfig"
endmenu
```
